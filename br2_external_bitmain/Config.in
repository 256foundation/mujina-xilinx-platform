## br2_external_bitmain/Config.in
```kconfig
# Mujina Xilinx Platform Custom Packages Menu
source "$BR2_EXTERNAL_XILINX_BITMAIN_PATH/packages/mujina/Config.in"
```

## br2_external_bitmain/board/xilinx/ramdisk-fit.its
```
/dts-v1/;

/*
 * Ramdisk FIT Image Template
 *
 * NOTE: This FIT image intentionally does NOT contain a hash node.
 * U-Boot verifies the ramdisk SHA256 against mtd3 bytes 1024-1279,
 * which is updated by install_ramdisk_to_nand.sh during installation.
 * See CLAUDE.md for details on the signature update method.
 */

/ {
	description = "Ramdisk";
	#address-cells = <1>;

	images {
		ramdisk {
			description = "Ramdisk";
			data = /incbin/("./rootfs.ext2.gz");
			type = "ramdisk";
			arch = "arm";
			os = "linux";
			compression = "gzip";
			load = <0>;
			entry = <0>;
		};
	};

	configurations {
		default = "def-conf";

		def-conf {
			description = "Default configuration";
			ramdisk = "ramdisk";
		};
	};
};
```

## br2_external_bitmain/board/xilinx/ramdisk.its
```
/dts-v1/;

/ {
    description = "Ramdisk";
    #address-cells = <1>;

    images {
        ramdisk {
            description = "Ramdisk";
            data = /incbin/("rootfs.ext2.gz");
            type = "ramdisk";
            arch = "arm";
            os = "linux";
            compression = "gzip";
        };
    };

    configurations {
        default = "config-1";

        config-1 {
            description = "Default configuration";
            ramdisk = "ramdisk";
        };
    };
};
```

## br2_external_bitmain/configs/xilinx_ramdisk_defconfig
```kconfig
# shellcheck disable=all

# Architecture
BR2_arm=y
BR2_cortex_a9=y
BR2_ARM_ENABLE_NEON=y
BR2_ARM_ENABLE_VFP=y
BR2_ARM_FPU_VFPV3D16=y

# Global patch directory for package patches
BR2_GLOBAL_PATCH_DIR="$(BR2_EXTERNAL_XILINX_BITMAIN_PATH)/board/xilinx/patches"

# Toolchain - Linaro GCC 7.2-2017.11 (EXACT match for stock kernel modules)
# Stock kernel & modules were built with: gcc version 7.2.1 20171011 (Linaro GCC 7.2-2017.11)
# BR2_TOOLCHAIN_BUILDROOT is not set
BR2_TOOLCHAIN_EXTERNAL=y
BR2_TOOLCHAIN_EXTERNAL_CUSTOM=y
BR2_TOOLCHAIN_EXTERNAL_DOWNLOAD=y
BR2_TOOLCHAIN_EXTERNAL_URL="https://releases.linaro.org/components/toolchain/binaries/7.2-2017.11/arm-linux-gnueabihf/gcc-linaro-7.2.1-2017.11-x86_64_arm-linux-gnueabihf.tar.xz"
BR2_TOOLCHAIN_EXTERNAL_CUSTOM_PREFIX="arm-linux-gnueabihf"
BR2_TOOLCHAIN_EXTERNAL_GCC_7=y

# Enable toolchain features for GDB support
BR2_TOOLCHAIN_EXTERNAL_HAS_SSP=y
BR2_TOOLCHAIN_EXTERNAL_INET_RPC=y
BR2_TOOLCHAIN_EXTERNAL_CXX=y
BR2_TOOLCHAIN_EXTERNAL_FORTRAN=y
BR2_TOOLCHAIN_EXTERNAL_OPENMP=y
BR2_TOOLCHAIN_EXTERNAL_HEADERS_4_10=y
BR2_TOOLCHAIN_EXTERNAL_CUSTOM_GLIBC=y
BR2_TOOLCHAIN_EXTERNAL_LOCALE=y
BR2_TOOLCHAIN_EXTERNAL_WCHAR=y

# System configuration
BR2_TARGET_GENERIC_HOSTNAME="mujina"
BR2_TARGET_GENERIC_ISSUE="Mujina Xilinx"
BR2_ROOTFS_DEVICE_CREATION_DYNAMIC_MDEV=y
BR2_ROOTFS_OVERLAY="$(BR2_EXTERNAL_XILINX_BITMAIN_PATH)/board/xilinx/rootfs-overlay"
# Root password = "root" (for development/testing)
BR2_TARGET_GENERIC_ROOT_PASSWD="root"
BR2_SYSTEM_DHCP="eth0"
# Use bash as default shell
BR2_SYSTEM_BIN_SH_BASH=y

# Build options - optimize for size
BR2_OPTIMIZE_S=y
BR2_ENABLE_LTO=y

# NO BOOTLOADER - Using stock BOOT.bin from NAND
# BR2_TARGET_UBOOT is not set

# NO KERNEL BUILD - Using stock kernel 4.6.0-xilinx from NAND (RSA-locked)
# Stock kernel modules (bitmain_axi.ko, fpga_mem_driver.ko) are pre-compiled
# and installed from board/xilinx/kernel_modules/
# BR2_LINUX_KERNEL is not set

# Filesystem - ext4 ramdisk for FIT image packaging
BR2_TARGET_ROOTFS_EXT2=y
BR2_TARGET_ROOTFS_EXT2_4=y
BR2_TARGET_ROOTFS_EXT2_SIZE="32M"

# Essential packages only
BR2_PACKAGE_BUSYBOX=y
BR2_PACKAGE_BUSYBOX_CONFIG="$(BR2_EXTERNAL_XILINX_BITMAIN_PATH)/board/xilinx/busybox.config"
BR2_PACKAGE_BUSYBOX_SHOW_OTHERS=y

# Shell
BR2_PACKAGE_BASH=y
BR2_PACKAGE_BASH_COMPLETION=y
BR2_PACKAGE_NCURSES=y
BR2_PACKAGE_READLINE=y

# Network tools
BR2_PACKAGE_DROPBEAR=y
BR2_PACKAGE_ETHTOOL=y
BR2_PACKAGE_ETHTOOL_PRETTY_PRINT=y

# System utilities
BR2_PACKAGE_I2C_TOOLS=y
BR2_PACKAGE_MTD=y
BR2_PACKAGE_MTD_NANDWRITE=y
BR2_PACKAGE_MTD_NANDDUMP=y
BR2_PACKAGE_MTD_FLASH_ERASE=y
BR2_PACKAGE_UTIL_LINUX=y
BR2_PACKAGE_UTIL_LINUX_BINARIES=y

# Debug tools - DISABLED
# BR2_PACKAGE_GDB is not set
# BR2_PACKAGE_STRACE is not set

# Host U-Boot tools with FIT support for ramdisk.itb creation
BR2_PACKAGE_HOST_UBOOT_TOOLS_FIT_SUPPORT=y

# Host genimage for SD card image creation
BR2_PACKAGE_HOST_GENIMAGE=y
BR2_PACKAGE_HOST_MTOOLS=y
BR2_PACKAGE_HOST_DOSFSTOOLS=y

# Custom Xilinx packages
# Mujina - Bitcoin ASIC miner software
BR2_PACKAGE_MUJINA=y
# BR2_PACKAGE_MUJINA_GITHUB_RELEASE=y
# BR2_PACKAGE_MUJINA_VERSION="latest"
# Using local build from source (git submodule):
BR2_PACKAGE_MUJINA_LOCAL_BUILD=y
BR2_PACKAGE_MUJINA_LOCAL_PATH="$(BR2_EXTERNAL_XILINX_BITMAIN_PATH)/../mujina"

# Rust host toolchain (using system cargo with ARM target instead of buildroot rustc)
# BR2_PACKAGE_HOST_RUSTC=y

# Build scripts
BR2_ROOTFS_POST_BUILD_SCRIPT="$(BR2_EXTERNAL_XILINX_BITMAIN_PATH)/board/xilinx/post-build.sh"
BR2_ROOTFS_POST_IMAGE_SCRIPT="$(BR2_EXTERNAL_XILINX_BITMAIN_PATH)/board/xilinx/post-image-ramdisk.sh"

# Host tools for FIT image creation
BR2_PACKAGE_HOST_DTC=y
BR2_PACKAGE_HOST_UBOOT_TOOLS=y
```

## br2_external_bitmain/packages/mujina/Config.in
```kconfig
config BR2_PACKAGE_MUJINA
	bool "mujina"
	help
	  Mujina - Bitcoin ASIC miner software

	  ASIC communication and mining protocol implementation for
	  Bitmain miners.

	  https://github.com/256foundation/mujina

if BR2_PACKAGE_MUJINA

choice
	prompt "Mujina source"
	default BR2_PACKAGE_MUJINA_GITHUB_RELEASE
	help
	  Select where to obtain mujina binary

config BR2_PACKAGE_MUJINA_GITHUB_RELEASE
	bool "GitHub release (pre-built)"
	help
	  Download pre-built binary from GitHub releases

config BR2_PACKAGE_MUJINA_LOCAL_BUILD
	bool "Local build (from source)"
	help
	  Build from local mujina repository

endchoice

config BR2_PACKAGE_MUJINA_VERSION
	string "GitHub release version"
	depends on BR2_PACKAGE_MUJINA_GITHUB_RELEASE
	default "latest"
	help
	  GitHub release tag (e.g., "v1.0.0") or "latest"

config BR2_PACKAGE_MUJINA_LOCAL_PATH
	string "Local mujina repository path"
	depends on BR2_PACKAGE_MUJINA_LOCAL_BUILD
	default "$(BR2_EXTERNAL_XILINX_BITMAIN_PATH)/../mujina"
	help
	  Path to mujina repository for local build

endif
```
